


/ {
	channel-id-map =
		"acg",
		"amxbr",
		"amxpr",
		"amxmx",
		"amxcl",
		"amxar",
		"amxla",
		"amxpe",
		"amxco",
		"tefbr",
		"tefmx",
		"tefar",
		"tefcl",
		"tefpe",
		"tefco",
		"perar",
		"entcl",
		"iusmx",
		"niibr",
		"niicl",
		"niimx",
		"niipe",
		"oibr",
		"timbr",
		"tigco",
		"retbr",
		"retar",
		"retla",
		"retcl",
		"tefla",
		"retla1st",
		"tefunl",
		"tigca",
		"tigca1st",
		"retmx",
		"attmx",
		"womcl",
		"avaco",
		"retpe",
		"undefined",
		"undefined",
		"undefined",
		"undefined",
		"undefined",
		"undefined",
		"undefined",
		"undefined",
		"undefined",
		"undefined",
		"undefined",
		"undefined",
		"undefined",
		"undefined",
		"undefined",
		"undefined",
		"undefined",
		"undefined",
		"undefined",
		"undefined",
		"undefined",
		"undefined",
		"undefined",
		"undefined",
		"undefined",
		"reteu",
		"retgb",
		"retfr",
		"retes",
		"retie",
		"retde",
		"vfgb",
		"vfde",
		"vffr",
		"o2gb",
		"o2de",
		"orafr",
		"bouyfr",
		"eegb",
		"tescogb",
		"yoigo",
		"oraes",
		"retapac",
		"retmea",
		"vfit",
		"vfes",
		"vfeu",
		"3gb",
		"tescoie",
		"altfr",
		"undefined",
		"undefined",
		"undefined",
		"undefined",
		"undefined",
		"undefined",
		"undefined",
		"undefined",
		"undefined",
		"undefined",
		"undefined",
		"undefined",
		"undefined",
		"undefined",
		"undefined",
		"undefined",
		"undefined",
		"undefined",
		"undefined",
		"undefined",
		"undefined",
		"undefined",
		"undefined",
		"undefined",
		"undefined",
		"undefined",
		"undefined",
		"undefined",
		"undefined",
		"undefined",
		"undefined",
		"undefined",
		"undefined",
		"undefined",
		"undefined",
		"undefined",
		"undefined",
		"undefined",
		"undefined",
		"retca",
		"bwaca",
		"tkpca",
		"vzw",
		"att",
		"tmo",
		"sprint",
		"repw",
		"aio",
		"???",
		"cc",
		"usc",
		"tracfone",
		"retus",
		"???",
		"rcica",
		"wndca",
		"dmc",
		"bby",
		"amz",
		"acg",
		"lra",
		"undefined",
		"undefined",
		"undefined",
		"undefined",
		"undefined",
		"undefined",
		"undefined",
		"undefined",
		"undefined",
		"undefined",
		"undefined",
		"undefined",
		"undefined",
		"undefined",
		"undefined",
		"undefined",
		"undefined",
		"undefined",
		"undefined",
		"undefined",
		"undefined",
		"undefined",
		"undefined",
		"undefined",
		"undefined",
		"undefined",
		"undefined",
		"undefined",
		"undefined",
		"undefined",
		"undefined",
		"undefined",
		"undefined",
		"undefined",
		"undefined",
		"undefined",
		"undefined",
		"undefined",
		"undefined",
		"undefined",
		"undefined",
		"undefined",
		"retin",
		"retcn",
		"telstra",
		"vfau",
		"amzin",
		"jioin",
		"airin",
		"retid",
		"undefined",
		"undefined",
		"undefined",
		"undefined",
		"undefined",
		"undefined",
		"undefined",
		"undefined",
		"undefined",
		"undefined",
		"undefined",
		"undefined",
		"undefined",
		"undefined",
		"undefined",
		"undefined",
		"undefined",
		"undefined",
		"undefined",
		"undefined",
		"undefined",
		"undefined",
		"undefined",
		"undefined",
		"undefined",
		"undefined",
		"undefined",
		"undefined",
		"undefined",
		"undefined",
		"undefined",
		"undefined",
		"undefined",
		"undefined",
		"undefined",
		"undefined",
		"undefined",
		"undefined",
		"undefined",
		"undefined",
		"undefined",
		"undefined",
		"undefined",
		"undefined",
		"undefined",
		"undefined",
		"undefined",
		"undefined",
		"undefined",
		"undefined",
		"undefined",
		"undefined",
		"undefined",
		"undefined",
		"undefined",
		"undefined";
};
